## config/boards/shields/sofle_art/Kconfig.shield
```kconfig
# Copyright (c) 2022 The ZMK Contributors
# SPDX-License-Identifier: MIT

config SHIELD_SOFLE_ART
    def_bool $(shields_list_contains,sofle_art)
```
